## build/conf/local.conf
```bitbake
MACHINE = "raspberrypi5"
DISTRO = "poky"

BB_NUMBER_THREADS = "6"
BB_NUMBER_PARSE_THREADS = "6"
PARALLEL_MAKE = "-j 6"
PARALLEL_MAKEINST = "-j 6"

# Shared cache
SSTATE_DIR = "${TOPDIR}/../sstate-cache"
DL_DIR = "${TOPDIR}/../downloads"

# Remove intermediate files
INHERIT += "rm_work"

#setup u-boot
#RPI_USE_U_BOOT = "1"

# Systemd initialization manager fix
INIT_MANAGER = "systemd"
DISTRO_FEATURES:append = " systemd"
DISTRO_FEATURES_OPTED_OUT += "sysvinit"
VIRTUAL-RUNTIME_init_manager = "systemd"
VIRTUAL-RUNTIME_initscripts = "systemd-compat-units"

# Required licenses for Raspberry Pi 5
LICENSE_FLAGS_ACCEPTED = "synaptics-killswitch"

# Packaging 
PACKAGE_CLASSES = "package_ipk"

# Custom tools
IMAGE_INSTALL:append = " unblock-wifi hello-c"
DISTRO_FEATURES:append = " static-ip-address"


#enables ssh
EXTRA_IMAGE_FEATURES:append = " ssh-server-dropbear"

#enable users
INHERIT += "extrausers"
IMAGE_INSTALL:append =  " sudo"
EXTRA_USERS_PARAMS += "useradd -p '\$6\$sVl59HLbdtsoPUTD\$jM6cCipSrWgLpShkc4HkgLxZna4frVuRli2.ONcLYLMB5KK5X6eDaQ/KjBT9OXLrQbyolT/IBMO1YIEP6BpFL1' marcos; \
                        usermod -a -G sudo marcos; \
                        "



#BB_PRESSURE_MAX_CPU = "900000"
IMAGE_INSTALL:append = " psplash"
# adding PyQT6

#IMAGE_INSTALL:append = " qtbase-dev qtbase-tools"
#DISTRO_FEATURES:append = " wayland opengl"

IMAGE_INSTALL:append = " python3-pyqt5"
IMAGE_INSTALL:append = " hello-python"
IMAGE_INSTALL:append = " nano"
IMAGE_INSTALL:append = " python3-pip"
IMAGE_INSTALL:append = " spedo"

# Adding speedometer 
#IMAGE_INSTALL:append = " spedo"
```

## meta-myowndisto/conf/distro/myowndisto.conf
```bitbake
DISTRO = "myowndisto"
DISTRO_NAME = "MARCOS"
DISTRO_VERSION = "2.0"

include conf/distro/defaultsetup.conf

PACKAGE_CLASSES ?= "package_ipk" 
VIRTUAL-RUNTIME_init_manager = "systemd"
DISTRO_FEATURES ?= "largefile opengl pcmcia usbhost wifi systemd"
```
