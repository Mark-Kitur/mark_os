## build/conf/bblayers.conf
```bitbake
BBLAYERS ?= " \
  /home/mark/yocto_ws/bitbake-builds/mark_os/layers/openembedded-core/meta \
  /home/mark/yocto_ws/bitbake-builds/mark_os/layers/meta-yocto/meta-yocto-bsp \
  /home/mark/yocto_ws/bitbake-builds/mark_os/layers/meta-yocto/meta-poky \
  /home/mark/yocto_ws/meta-raspberrypi \
  /home/mark/yocto_ws/bitbake-builds/mark_os/meta-root_v1 \
  "
```

## meta-root_v1/conf/layer.conf
```bitbake
# We have a conf and classes directory, add to BBPATH
BBPATH .= ":${LAYERDIR}"

# We have recipes-* directories, add to BBFILES
BBFILES += "${LAYERDIR}/recipes-*/*/*.bb \
            ${LAYERDIR}/recipes-*/*/*.bbappend"

BBFILE_COLLECTIONS += "meta-root_v1"
BBFILE_PATTERN_meta-root_v1 = "^${LAYERDIR}/"
BBFILE_PRIORITY_meta-root_v1 = "6"

LAYERDEPENDS_meta-root_v1 = "core"
LAYERSERIES_COMPAT_meta-root_v1 = "whinlatter"
```
